#include "xiaomi-sm8650-common.dtsi"

&cdc_quat_mi2s_gpios {
	pinctrl-0 = <&quat_tdm_sck_active &quat_tdm_ws_active
		&quat_tdm_sd0_active &quat_tdm_sd1_active
		&quat_tdm_sd2_active &quat_tdm_sd3_active>;
	pinctrl-1 = <&quat_tdm_sck_sleep &quat_tdm_ws_sleep
		&quat_tdm_sd0_sleep &quat_tdm_sd1_sleep
		&quat_tdm_sd2_sleep &quat_tdm_sd3_sleep>;
};

&cdc_quin_mi2s_gpios {
	pinctrl-0 = <&lpi_tdm1_sck_active &lpi_tdm1_ws_active
		&lpi_tdm1_sd0_active &lpi_tdm1_sd1_active>;
	pinctrl-1 = <&lpi_tdm1_sck_sleep &lpi_tdm1_ws_sleep
		&lpi_tdm1_sd0_sleep &lpi_tdm1_sd1_sleep>;
};

&cdc_sen_mi2s_gpios {
	pinctrl-0 = <&lpi_tdm2_sck_active &lpi_tdm2_ws_active
		&lpi_tdm2_sd0_active &lpi_tdm2_sd1_active>;
	pinctrl-1 = <&lpi_tdm2_sck_sleep &lpi_tdm2_ws_sleep
		&lpi_tdm2_sd0_sleep &lpi_tdm2_sd1_sleep>;
};

&pineapple_snd {
	qcom,audio-routing =
		"AMIC1", "Analog Mic1",
		"AMIC1", "MIC BIAS1",
		"AMIC2", "Analog Mic2",
		"AMIC2", "MIC BIAS2",
		"AMIC3", "Analog Mic3",
		"AMIC3", "MIC BIAS1",
		"AMIC4", "Analog Mic4",
		"AMIC4", "MIC BIAS4",
		"AMIC5", "Analog Mic5",
		"AMIC5", "MIC BIAS3",
		"VA AMIC1", "Analog Mic1",
		"VA AMIC1", "VA MIC BIAS1",
		"VA AMIC2", "Analog Mic2",
		"VA AMIC2", "VA MIC BIAS2",
		"VA AMIC3", "Analog Mic3",
		"VA AMIC3", "VA MIC BIAS3",
		"VA AMIC4", "Analog Mic4",
		"VA AMIC4", "VA MIC BIAS3",
		"VA AMIC5", "Analog Mic5",
		"VA AMIC5", "VA MIC BIAS4",
		"TX DMIC0", "Digital Mic0",
		"Digital Mic0", "MIC BIAS3",
		"TX DMIC1", "Digital Mic1",
		"Digital Mic1", "MIC BIAS3",
		"TX DMIC2", "Digital Mic2",
		"Digital Mic2", "MIC BIAS1",
		"TX DMIC3", "Digital Mic3",
		"Digital Mic3", "MIC BIAS1",
		"IN1_HPHL", "HPHL_OUT",
		"IN2_HPHR", "HPHR_OUT",
		"IN3_EAR", "AUX_OUT",
		"HAP_IN", "PCM_OUT",
		"RX_TX DEC0_INP", "TX DEC0 MUX",
		"RX_TX DEC1_INP", "TX DEC1 MUX",
		"RX_TX DEC2_INP", "TX DEC2 MUX",
		"RX_TX DEC3_INP", "TX DEC3 MUX",
		"TX SWR_INPUT", "WCD_TX_OUTPUT",
		"VA SWR_INPUT", "VA_SWR_CLK",
		"VA SWR_INPUT", "WCD_TX_OUTPUT",
		"VA_AIF1 CAP", "VA_SWR_CLK",
		"VA_AIF2 CAP", "VA_SWR_CLK",
		"VA_AIF3 CAP", "VA_SWR_CLK",
		"VA DMIC0", "Digital Mic0",
		"VA DMIC1", "Digital Mic1",
		"VA DMIC2", "Digital Mic2",
		"VA DMIC3", "Digital Mic3",
		"Digital Mic0", "VA MIC BIAS3",
		"Digital Mic1", "VA MIC BIAS3",
		"Digital Mic2", "VA MIC BIAS1",
		"Digital Mic3", "VA MIC BIAS1";
		qcom,ext-disp-audio-rx = <0x01>;
};
